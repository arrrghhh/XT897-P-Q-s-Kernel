## drivers/char/diag/Kconfig
```kconfig
menu "Diag Support"

config DIAG_CHAR
	tristate "char driver interface and diag forwarding to/from modem"
	default m
	depends on USB_G_ANDROID || USB_FUNCTION_DIAG || USB_QCOM_MAEMO || DIAG_INTERNAL
	depends on ARCH_MSM
	help
	 Char driver interface for diag user space and diag-forwarding to modem ARM and back.
	 This enables diagchar for maemo usb gadget or android usb gadget based on config selected.
endmenu

menu "DIAG traffic over USB"

config DIAG_OVER_USB
	bool "Enable DIAG traffic to go over USB"
        depends on ARCH_MSM
	default y
	help
	 This feature helps segregate code required for DIAG traffic to go over USB.
endmenu

menu "SDIO support for DIAG"

config DIAG_SDIO_PIPE
	depends on MSM_SDIO_AL
	default y
	bool "Enable 9K DIAG traffic over SDIO"
	help
	 SDIO Transport Layer for DIAG Router
endmenu

menu "HSIC support for DIAG"

config DIAG_HSIC_PIPE
	depends on USB_QCOM_DIAG_BRIDGE
	default y
	bool "Enable 9K DIAG traffic over HSIC"
	help
	 HSIC Transport Layer for DIAG Router
endmenu

menu "DIAG EXTENSION"

config DIAG_EXTENSION
	bool "This is a glue which add something on to diag driver"
	default n
	depends on DIAG_CHAR
	help
	 This feature is used for extension of DIAG CHAR.
	 It has a role of the glue between DIAG and extension.
	 Unless you use extension, disable it because this feature has
	 no meaning.
endmenu

menu "DIAG EXTENSION - Slate"
config DIAG_EXTENSION_SLATE
	tristate "Enable extension for slate feature of sprint"
	default n
	depends on DIAG_CHAR
	select DIAG_EXTENSION
	help
	 This extension is kernel part of slate feature of sprint.
	 If you use slate feature, you must enable it.
endmenu
```

## drivers/nfc/Kconfig
```kconfig
#
# Near Field Communication (NFC) devices
#

config PN544
	bool "PN544 NFC driver"
	depends on I2C
	default n
	---help---
	  NXP PN544 Near Field Communication controller support.
```
